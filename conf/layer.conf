## conf/layer.conf
```bitbake
# Layer configuration for meta-cyclonev-k3s
# Provides k3s (lightweight Kubernetes) support for Intel Cyclone V SoC FPGA

# We have a conf directory, add to BBPATH
BBPATH .= ":${LAYERDIR}/.."

# We have recipes-* directories, add to BBFILES
BBFILES += "${LAYERDIR}/../recipes-*/*/*.bb \
            ${LAYERDIR}/../recipes-*/*/*.bbappend"

BBFILE_COLLECTIONS += "meta-cyclonev-k3s"
BBFILE_PATTERN_meta-cyclonev-k3s = "^${LAYERDIR}/../"
BBFILE_PRIORITY_meta-cyclonev-k3s = "6"

LAYERDEPENDS_meta-cyclonev-k3s = "core meta-intel-fpga"
LAYERSERIES_COMPAT_meta-cyclonev-k3s = "kirkstone"
```
